#include "U8glib.h"
U8GLIB_ST7920_128X64 u8g(13, 11, 12, U8G_PIN_NONE);

static unsigned char dispaly_power_import[] U8G_PROGMEM = {
   0x00, 0x00, 0x00, 0x00, 0x00, 0x00, 0x00, 0x00, 0x00, 0x00, 0x00, 0x00,
   0x00, 0x00, 0x00, 0x00, 0x00, 0x00, 0x00, 0x00, 0x00, 0x00, 0x00, 0x00,
   0xc0, 0x3b, 0x77, 0x00, 0x52, 0x95, 0x40, 0x48, 0x92, 0x00, 0x4a, 0x95,
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   0x00, 0x00, 0x00, 0x00, 0x00, 0x00, 0x00, 0x00, 0x00, 0x00, 0x00, 0x00 
   };

static unsigned char dispaly_power_export[] U8G_PROGMEM = {
   0x00, 0x00, 0x00, 0x00, 0x00, 0x00, 0x00, 0x00, 0x00, 0x00, 0x00, 0x00,
   0x00, 0x00, 0x00, 0x00, 0x00, 0x00, 0x00, 0x00, 0x00, 0x00, 0x00, 0x00,
   0xc0, 0x3b, 0x77, 0x00, 0x52, 0x95, 0x40, 0x48, 0x92, 0x00, 0x4a, 0x95,
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   0x00, 0x00, 0x00, 0x00, 0x00, 0x00, 0x00, 0x00, 0x00, 0x00, 0x00, 0x00 
   };

String value_power_from_grid = "";
String value_power_to_grid = "";
String value_power = "";

void update_screen(void) {
  if (value_power.toInt() >= 0){
    u8g.drawXBMP( 0, 0, 48, 64, dispaly_power_import);
  }
  else
  {
   u8g.drawXBMP( 0, 0, 48, 64, dispaly_power_export); 
  }
  
  u8g.setFont(u8g_font_helvB10);
  u8g.drawStr( 50, 17, value_power_from_grid.c_str());
  u8g.drawStr( 50, 38, value_power.c_str());
  u8g.drawStr( 50, 60, value_power_to_grid.c_str());
}

void setup(void) {
  if ( u8g.getMode() == U8G_MODE_R3G3B2 ) {
    u8g.setColorIndex(255);
  }
  else if ( u8g.getMode() == U8G_MODE_GRAY2BIT ) {
    u8g.setColorIndex(3);
  }
  else if ( u8g.getMode() == U8G_MODE_BW ) {
    u8g.setColorIndex(1);
  }
  else if ( u8g.getMode() == U8G_MODE_HICOLOR ) {
    u8g.setHiColorByRGB(255,255,255);
  }
  pinMode(8, OUTPUT); //LED
  digitalWrite(8, HIGH); //LED
  Serial.begin(9600);
  Serial.setTimeout(10);
}

void loop(void) {

  if (Serial.available() > 0) {
    value_power_from_grid = Serial.readStringUntil(';');
    value_power_to_grid = Serial.readStringUntil(';');
    value_power = Serial.readStringUntil(';');
    Serial.print("From" + value_power_from_grid + ";");
    Serial.print("To" + value_power_to_grid + ";");
    Serial.print("Power" + value_power);
    update_screen();
  }
  
  u8g.firstPage();  
  do {
    update_screen();
  } while( u8g.nextPage() );
}
